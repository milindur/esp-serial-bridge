## main/Kconfig.projbuild
```kconfig
# SPDX-License-Identifier: MIT

menu "ESP-NOW Serial Bridge"

config BRIDGE_PEER_MAC
    string "Peer WiFi STA MAC address (required)"
    default "94:B9:7E:D9:DD:D4"
    help
        Required WiFi STA MAC address of the opposite board, formatted as AA:BB:CC:DD:EE:FF.

config BRIDGE_WIFI_CHANNEL
    int "WiFi / ESP-NOW channel"
    range 1 13
    default 13

config BRIDGE_WIFI_COUNTRY
    string "WiFi country code"
    default "DE"

config BRIDGE_WIFI_MAX_TX_POWER
    int "Maximum WiFi TX power (quarter-dBm)"
    range 8 84
    default 72
    help
        ESP-IDF uses quarter-dBm units. 72 equals 18 dBm.

config BRIDGE_BAUD_RATE
    int "Bridge UART baud rate"
    range 4800 921600
    default 115200

config BRIDGE_UART_NUM
    int "Bridge UART number"
    range 0 2
    default 1

config BRIDGE_TX_PIN
    int "Bridge UART TX GPIO"
    default 1

config BRIDGE_RX_PIN
    int "Bridge UART RX GPIO"
    default 3

config BRIDGE_USE_USB_CDC
    bool "Use USB Serial/JTAG for bridge traffic"
    depends on SOC_USB_SERIAL_JTAG_SUPPORTED
    default n
    help
        Use the chip's native USB Serial/JTAG CDC ACM port for bridge traffic.
        This is the /dev/ttyACM* interface on ESP32-C3/S3/C6-class targets.
        Debug logs share the same port and may interfere with binary payload data.

config BRIDGE_PACKET_SPLIT_ON_LF
    bool "Flush UART packets on line feed"
    default n
    help
        Send a packet immediately when a '\n' byte is read from the UART.
        This is useful for line-oriented text protocols such as NMEA-0183.
        Leave disabled for binary protocols or protocols where LF has no
        framing meaning. The inter-byte timeout remains active as a fallback.

config BRIDGE_TX_QUEUE_DEPTH
    int "UART to ESP-NOW transmit queue depth"
    range 1 128
    default 16
    help
        Number of complete UART packets buffered before ESP-NOW transmission.
        Increasing this helps absorb RF stalls or AIS bursts at the cost of
        RAM. With the default 250-byte packet size, 16 packets buffer roughly
        4 KiB of payload plus FreeRTOS queue overhead.

config BRIDGE_RX_QUEUE_SIZE
    int "ESP-NOW RX byte queue size"
    range 64 65535
    default 1024

config BRIDGE_SEND_RETRY_DELAY_MS
    int "Delay before retrying esp_now_send() API errors (ms)"
    range 1 60000
    default 25

config BRIDGE_SEND_CALLBACK_TIMEOUT_MS
    int "Maximum wait for ESP-NOW send callback (ms)"
    range 10 60000
    default 1000
    help
        Maximum time to wait for ESP-NOW to report send success or failure
        after esp_now_send() accepted a packet. If no callback arrives in time,
        the packet is retried.

config BRIDGE_LED_PIN
    int "Activity LED GPIO"
    default 2

config BRIDGE_LED_NEOPIXEL
    bool "Activity LED is WS2812/NeoPixel"
    default n
    help
        Drive a single addressable RGB LED using the ESP-IDF led_strip
        component. Use this for boards with an onboard WS2812/NeoPixel LED,
        such as the Waveshare ESP32-C6-DEV-KIT-N8 RGB LED on GPIO8.

config BRIDGE_LED_ACTIVE_LOW
    bool "Activity LED is active low"
    depends on !BRIDGE_LED_NEOPIXEL
    default y

choice BRIDGE_LED_NEOPIXEL_COLOR_ORDER
    prompt "NeoPixel color component order"
    depends on BRIDGE_LED_NEOPIXEL
    default BRIDGE_LED_NEOPIXEL_COLOR_ORDER_GRB
    help
        Wire color order used by the addressable LED. Most WS2812 LEDs use
        GRB, but some onboard LEDs use RGB.

config BRIDGE_LED_NEOPIXEL_COLOR_ORDER_GRB
    bool "GRB"

config BRIDGE_LED_NEOPIXEL_COLOR_ORDER_RGB
    bool "RGB"

endchoice

config BRIDGE_LED_PULSE_MS
    int "Activity LED pulse length (ms)"
    range 1 10000
    default 25

config BRIDGE_BLINK_ON_SEND
    bool "Blink when an ESP-NOW send is started"
    default n

config BRIDGE_BLINK_ON_SEND_SUCCESS
    bool "Blink when an ESP-NOW send succeeds"
    default y

config BRIDGE_BLINK_ON_RECV
    bool "Blink when ESP-NOW data is received"
    default y

config BRIDGE_DEBUG
    bool "Enable debug telemetry logs"
    default n

config BRIDGE_DEBUG_TELEMETRY_INTERVAL_MS
    int "Debug telemetry polling interval (ms)"
    range 100 600000
    default 1000
    depends on BRIDGE_DEBUG

config BRIDGE_DIAGNOSTICS_WEB
    bool "Enable diagnostic web interface"
    depends on ESP_WIFI_ENABLE_WPA3_SAE && ESP_WIFI_SOFTAP_SAE_SUPPORT
    default n
    help
        Enable a read-only diagnostic HTTP page over a WPA3-only SoftAP.
        The SoftAP always uses CONFIG_BRIDGE_WIFI_CHANNEL, shared with ESP-NOW.
        HTTP listens on port 80 and exposes / plus /api/status.
        The netmask is fixed to /24 and the DHCP lease range is derived from
        the configured AP IP address automatically.

config BRIDGE_DIAGNOSTICS_AP_SSID
    string "Diagnostic SoftAP SSID"
    depends on BRIDGE_DIAGNOSTICS_WEB
    default "ESP-Serial-Bridge-Diag"
    help
        SSID for the WPA3-only diagnostic SoftAP.

config BRIDGE_DIAGNOSTICS_AP_PASSWORD
    string "Diagnostic SoftAP WPA3 passphrase"
    depends on BRIDGE_DIAGNOSTICS_WEB
    default "change-me-diag"
    help
        WPA3 SoftAP passphrase. Must be 8 to 63 characters.
        This is the only access boundary in v1; the HTTP UI has no separate
        authentication.

config BRIDGE_DIAGNOSTICS_AP_IP
    string "Diagnostic SoftAP IP address"
    depends on BRIDGE_DIAGNOSTICS_WEB
    default "192.168.4.1"
    help
        Gateway IP address for the diagnostic SoftAP. The netmask is fixed to
        255.255.255.0. DHCP leases are derived in the same /24, normally .2 to
        .20 unless that would conflict with this gateway address.

config BRIDGE_ESPNOW_ENCRYPTION
    bool "Enable ESP-NOW encryption"
    default n

config BRIDGE_ESPNOW_PMK_HEX
    string "ESP-NOW PMK (32 hex chars)"
    default "000102030405060708090A0B0C0D0E0F"
    depends on BRIDGE_ESPNOW_ENCRYPTION

config BRIDGE_ESPNOW_LMK_HEX
    string "ESP-NOW LMK (32 hex chars)"
    default "101112131415161718191A1B1C1D1E1F"
    depends on BRIDGE_ESPNOW_ENCRYPTION

endmenu
```

## sdkconfig.defaults.esp32c6_8mb_ota
```kconfig
# Waveshare ESP32-C6-Dev-Kit-N8 profile: 8 MB flash with OTA-ready partitioning.
CONFIG_IDF_TARGET="esp32c6"
CONFIG_ESPTOOLPY_FLASHSIZE_8MB=y
CONFIG_PARTITION_TABLE_CUSTOM=y
CONFIG_PARTITION_TABLE_CUSTOM_FILENAME="partitions_8mb_ota.csv"
CONFIG_PARTITION_TABLE_FILENAME="partitions_8mb_ota.csv"
```
